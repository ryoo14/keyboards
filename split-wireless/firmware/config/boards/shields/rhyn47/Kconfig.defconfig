## split-wireless/firmware/config/boards/shields/rhyn47/Kconfig.defconfig
```kconfig
if SHIELD_RHYN47_LEFT

config ZMK_KEYBOARD_NAME
    default "rhyn47"

endif

if SHIELD_RHYN47_RIGHT

config ZMK_KEYBOARD_NAME
    default "rhyn47"

# 右手をセントラル（PC と BLE 接続する親）にする。
# トラボが右手にあるので、ポインタの高頻度データを分割リンクに流さずに済む。
config ZMK_SPLIT_ROLE_CENTRAL
    default y

endif

if SHIELD_RHYN47_LEFT || SHIELD_RHYN47_RIGHT

config ZMK_SPLIT
    default y

endif
```

## split-wireless/firmware/config/boards/shields/rhyn47/Kconfig.shield
```kconfig
config SHIELD_RHYN47_LEFT
    def_bool $(shields_list_contains,rhyn47_left)

config SHIELD_RHYN47_RIGHT
    def_bool $(shields_list_contains,rhyn47_right)
```

## split-wireless/firmware/config/west.yml
```yaml
manifest:
  remotes:
    - name: zmkfirmware
      url-base: https://github.com/zmkfirmware
    - name: badjeff
      url-base: https://github.com/badjeff
  projects:
    - name: zmk
      remote: zmkfirmware
      revision: main
      import: app/west.yml
    # PMW3610 ドライバ。compatible / CONFIG 名は README で最終照合すること
    # （notes §7-1, §14）。別フォークに替えるならここと
    # rhyn47_right.overlay / rhyn47_right.conf の3箇所を揃える。
    - name: zmk-pmw3610-driver
      remote: badjeff
      revision: main
  self:
    path: config
```
